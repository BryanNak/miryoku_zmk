// Copyright 2021 Manna Harbour
// https://github.com/manna-harbour/miryoku

#include "miryoku_behaviors_extra.dtsi"
#include "../miryoku/custom_config.h"
#include "../miryoku/mapping/42/corne.h"
#include "../miryoku/miryoku.dtsi"
